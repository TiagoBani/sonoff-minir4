## minir4-homekit/components/esp_hap_platform/Kconfig
```kconfig
rsource "../../../esp-homekit-reference/components/homekit/esp_hap_platform/Kconfig"
```

## minir4-homekit/sdkconfig.defaults
```kconfig
CONFIG_ESP_WIFI_NVS_ENABLED=n
CONFIG_HTTPD_MAX_URI_LEN=128
CONFIG_HTTPD_MAX_REQ_HDR_LEN=1024
CONFIG_ESP_MAIN_TASK_STACK_SIZE=12288
CONFIG_ESPTOOLPY_FLASHMODE_DIO=y
CONFIG_ESPTOOLPY_FLASHFREQ_40M=y
CONFIG_ESPTOOLPY_FLASHSIZE_4MB=y
CONFIG_PARTITION_TABLE_CUSTOM=y
CONFIG_BOOTLOADER_APP_ROLLBACK_ENABLE=n
CONFIG_ESP_SYSTEM_ESP32_SRAM1_REGION_AS_IRAM=n
CONFIG_HAP_MFI_ENABLE=n
CONFIG_HAP_HTTP_SERVER_PORT=80
CONFIG_HAP_PLATFORM_DEF_NVS_RUNTIME_PARTITION="reserve"
CONFIG_HAP_PLATFORM_DEF_NVS_FACTORY_PARTITION="reserve"
CONFIG_LWIP_MAX_SOCKETS=16
CONFIG_HAP_HTTP_MAX_OPEN_SOCKETS=4
```
